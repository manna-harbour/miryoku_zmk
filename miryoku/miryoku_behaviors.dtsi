// Copyright 2022 Manna Harbour
// https://github.com/manna-harbour/miryoku

/ {
  behaviors {
    u_mt: u_mt {
      compatible = "zmk,behavior-hold-tap";
      #binding-cells = <2>;
      tapping-term-ms = <U_TAPPING_TERM>;
      quick-tap-ms = <U_QUICK_TAP>;
      flavor = "tap-preferred";
      bindings = <&kp>, <&kp>;
    };
    u_lt: u_lt {
      compatible = "zmk,behavior-hold-tap";
      #binding-cells = <2>;
      tapping-term-ms = <U_TAPPING_TERM>;
      quick-tap-ms = <U_QUICK_TAP>;
      flavor = "tap-preferred";
      bindings = <&mo>, <&kp>;
    };
  };
};
