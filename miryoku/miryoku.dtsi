// Copyright 2022 Manna Harbour
// https://github.com/manna-harbour/miryoku

#include <behaviors.dtsi>
#include <behaviors/mouse_keys.dtsi>
#include <dt-bindings/zmk/keys.h>
#include <dt-bindings/zmk/bt.h>
#include <dt-bindings/zmk/rgb.h>
#include <dt-bindings/zmk/outputs.h>
#include <dt-bindings/zmk/ext_power.h>

#include "miryoku.h"

#include <dt-bindings/zmk/pointing.h>

/ {
  keymap {
    compatible = "zmk,keymap";
#define MIRYOKU_X(LAYER, STRING) \
    LAYER { \
      display-name = STRING; \
      bindings = < U_MACRO_VA_ARGS(MIRYOKU_LAYERMAPPING_##LAYER, MIRYOKU_LAYER_##LAYER) >; \
    };
MIRYOKU_LAYER_LIST
#undef MIRYOKU_X
  };
};

#include "miryoku_shift_functions.dtsi"

#include "miryoku_double_tap_guard.dtsi"

#include "miryoku_mousekeys.dtsi"

#if defined (MIRYOKU_KLUDGE_THUMBCOMBOS)
  #include "miryoku_kludge_thumbcombos.dtsi"
#endif

#if defined (MIRYOKU_KLUDGE_TOPROWCOMBOS)
  #include "miryoku_kludge_toprowcombos.dtsi"
#endif

#if defined (MIRYOKU_KLUDGE_BOTTOMROWCOMBOS)
  #include "miryoku_kludge_bottomrowcombos.dtsi"
#endif

#if defined (MIRYOKU_KLUDGE_TAPDELAY)
  #include "miryoku_kludge_tapdelay.dtsi"
#else
  #include "miryoku_behaviors.dtsi"
#endif
