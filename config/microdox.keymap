// Copyright 2021 Manna Harbour
// https://github.com/manna-harbour/miryoku

#define MIRYOKU_COMBO_TPS_ENABLE

#include "../miryoku/config.h"
#include "../miryoku/mapping/36-minidox.h"
#include "../miryoku/miryoku.dtsi"
