// generated from miryoku_zmk.org  -*- buffer-read-only: t -*-

//#include <behaviors.dtsi>
//#include <dt-bindings/zmk/keys.h>
//#include <dt-bindings/zmk/bt.h>

#define SUBMAP(\
      K00,  K01,  K02,  K03,  K04,         K05,  K06,  K07,  K08,  K09,\
      K10,  K11,  K12,  K13,  K14,         K15,  K16,  K17,  K18,  K19,\
      K20,  K21,  K22,  K23,  K24,         K25,  K26,  K27,  K28,  K29,\
      N30,  N31,  K32,  K33,  K34,         K35,  K36,  K37,  N38,  N39\
)\
&none K00   K01   K02   K03   K04          K05   K06   K07   K08   K09   &none \
&none K10   K11   K12   K13   K14          K15   K16   K17   K18   K19   &none \
&none K20   K21   K22   K23   K24          K25   K26   K27   K28   K29   &none \
                  K32   K33   K34          K35   K36   K37

#define BASE 0
#define MBO  1
#define MEDR 2
#define NAVR 3
#define MOUR 4
#define NSSL 5
#define NSL  6
#define FUNL 7

#define X_NP &none // key is not present
#define X_NA &none // present but not available for use
#define X_NU &none // available but not used

/ {
  behaviors {
    hm: homerow_mods {
      compatible = "zmk,behavior-hold-tap";
      label = "HOMEROW_MODS";
      #binding-cells = <2>;
      tapping_term_ms = <200>;
      flavor = "tap-preferred";
      bindings = <&kp>, <&kp>;
    };
  };
  keymap {
    compatible = "zmk,keymap";
      BASE_layer {
        bindings = <
#if defined MIRYOKU_ALPHAS_COLEMAK
          SUBMAP(
&kp Q,        &kp W,        &kp F,        &kp P,        &kp G,        &kp J,        &kp L,        &kp U,        &kp Y,        &kp QUOT,
&hm LGUI A,   &hm LALT R,   &hm LCTL S,   &hm LSFT T,   &kp D,        &kp H,        &hm LSFT N,   &hm LCTL E,   &hm LALT I,   &hm LGUI O,
&kp Z,        &hm ALGR X,   &kp C,        &kp V,        &kp B,        &kp K,        &kp M,        &kp COMM,     &hm ALGR DOT, &kp SLSH,
X_NP,         X_NP,         &lt MEDR ESC, &lt NAVR SPC, &lt MOUR TAB, &lt NSSL ENT, &lt NSL BSPC, &lt FUNL DEL, X_NP,         X_NP
          )
#elif defined MIRYOKU_ALPHAS_COLEMAKDH
          SUBMAP(
&kp Q,        &kp W,        &kp F,        &kp P,        &kp B,        &kp J,        &kp L,        &kp U,        &kp Y,        &kp QUOT,
&hm LGUI A,   &hm LALT R,   &hm LCTL S,   &hm LSFT T,   &kp G,        &kp K,        &hm LSFT N,   &hm LCTL E,   &hm LALT I,   &hm LGUI O,
&kp Z,        &hm ALGR X,   &kp C,        &kp D,        &kp V,        &kp M,        &kp H,        &kp COMM,     &hm ALGR DOT, &kp SLSH,
X_NP,         X_NP,         &lt MEDR ESC, &lt NAVR SPC, &lt MOUR TAB, &lt NSSL ENT, &lt NSL BSPC, &lt FUNL DEL, X_NP,         X_NP
          )
#elif defined MIRYOKU_ALPHAS_DVORAK
          SUBMAP(
&kp QUOT,     &kp COMM,     &kp DOT,      &kp P,        &kp Y,        &kp F,        &kp G,        &kp C,        &kp R,        &kp L,
&hm LGUI A,   &hm LALT O,   &hm LCTL E,   &hm LSFT U,   &kp I,        &kp D,        &hm LSFT H,   &hm LCTL T,   &hm LALT N,   &hm LGUI S,
&kp SLSH,     &hm ALGR Q,   &kp J,        &kp K,        &kp X,        &kp B,        &kp M,        &kp W,        &hm ALGR V,   &kp Z,
X_NP,         X_NP,         &lt MEDR ESC, &lt NAVR SPC, &lt MOUR TAB, &lt NSSL ENT, &lt NSL BSPC, &lt FUNL DEL, X_NP,         X_NP
          )
#elif defined MIRYOKU_ALPHAS_HALMAK
          SUBMAP(
&kp W,        &kp L,        &kp R,        &kp B,        &kp Z,        &kp QUOT,     &kp Q,        &kp U,        &kp D,        &kp J,
&hm LGUI S,   &hm LALT H,   &hm LCTL N,   &hm LSFT T,   &kp COMM,     &kp DOT,      &hm LSFT A,   &hm LCTL E,   &hm LALT O,   &hm LGUI I,
&kp F,        &hm ALGR M,   &kp V,        &kp C,        &kp SLSH,     &kp G,        &kp P,        &kp X,        &hm ALGR K,   &kp Y,
X_NP,         X_NP,         &lt MEDR ESC, &lt NAVR SPC, &lt MOUR TAB, &lt NSSL ENT, &lt NSL BSPC, &lt FUNL DEL, X_NP,         X_NP
          )
#elif defined MIRYOKU_ALPHAS_WORKMAN
          SUBMAP(
&kp Q,        &kp D,        &kp R,        &kp W,        &kp B,        &kp J,        &kp F,        &kp U,        &kp P,        &kp QUOT,
&hm LGUI A,   &hm LALT S,   &hm LCTL H,   &hm LSFT T,   &kp G,        &kp Y,        &hm LSFT N,   &hm LCTL E,   &hm LALT O,   &hm LGUI I,
&kp Z,        &hm ALGR X,   &kp M,        &kp C,        &kp V,        &kp K,        &kp L,        &kp COMM,     &hm ALGR DOT, &kp SLSH,
X_NP,         X_NP,         &lt MEDR ESC, &lt NAVR SPC, &lt MOUR TAB, &lt NSSL ENT, &lt NSL BSPC, &lt FUNL DEL, X_NP,         X_NP
          )
#elif defined MIRYOKU_ALPHAS_QWERTY
          SUBMAP(
&kp Q,        &kp W,        &kp E,        &kp R,        &kp T,        &kp Y,        &kp U,        &kp I,        &kp O,        &kp P,
&hm LGUI A,   &hm LALT S,   &hm LCTL D,   &hm LSFT F,   &kp G,        &kp H,        &hm LSFT J,   &hm LCTL K,   &hm LALT L,   &hm LGUI QUOT,
&kp Z,        &hm ALGR X,   &kp C,        &kp V,        &kp B,        &kp N,        &kp M,        &kp COMM,     &hm ALGR DOT, &kp SLSH,
X_NP,         X_NP,         &lt MEDR ESC, &lt NAVR SPC, &lt MOUR TAB, &lt NSSL ENT, &lt NSL BSPC, &lt FUNL DEL, X_NP,         X_NP
          )
#else
          SUBMAP(
&kp Q,        &kp W,        &kp F,        &kp P,        &kp B,        &kp J,        &kp L,        &kp U,        &kp Y,        &kp QUOT,
&hm LGUI A,   &hm LALT R,   &hm LCTL S,   &hm LSFT T,   &kp G,        &kp M,        &hm LSFT N,   &hm LCTL E,   &hm LALT I,   &hm LGUI O,
&kp Z,        &hm ALGR X,   &kp C,        &kp D,        &kp V,        &kp K,        &kp H,        &kp COMM,     &hm ALGR DOT, &kp SLSH,
X_NP,         X_NP,         &lt MEDR ESC, &lt NAVR SPC, &lt MOUR TAB, &lt NSSL ENT, &lt NSL BSPC, &lt FUNL DEL, X_NP,         X_NP
          )
#endif
        >;
      };
      MBO_layer {
        bindings = <
          SUBMAP(
&trans,   &trans,   &trans,   &trans,   &trans,   &trans,   &trans,   &trans,   &trans,   &trans,
&trans,   &trans,   &trans,   &trans,   &trans,   &trans,   &trans,   &trans,   &trans,   &trans,
&trans,   &trans,   &trans,   &trans,   &trans,   &trans,   &trans,   &trans,   &trans,   &trans,
X_NP,     X_NP,     &trans,   &trans,   &trans,   &kp BTN1, &kp BTN3, &kp BTN2, X_NP,     X_NP
          )
        >;
      };
      NAVR_layer {
        bindings = <
#if defined MIRYOKU_NAV_VI
          SUBMAP(
&rst,     X_NA,     X_NA,     X_NA,     X_NA,     &kp AGIN, &kp UNDO, &kp CUT,  &kp COPY, &kp PSTE,
&kp LGUI, &kp LALT, &kp LCTL, &kp LSFT, X_NA,     &kp LEFT, &kp DOWN, &kp UP,   &kp RGHT, &kp CAPS,
X_NA,     &kp ALGR, X_NA,     X_NA,     X_NA,     &kp HOME, &kp PGDN, &kp PGUP, &kp END,  &kp INS,
X_NP,     X_NP,     X_NA,     X_NA,     X_NA,     &kp ENT,  &kp BSPC, &kp DEL,  X_NP,     X_NP
          )
#else
          SUBMAP(
&rst,     X_NA,     X_NA,     X_NA,     X_NA,     &kp AGIN, &kp UNDO, &kp CUT,  &kp COPY, &kp PSTE,
&kp LGUI, &kp LALT, &kp LCTL, &kp LSFT, X_NA,     &kp CAPS, &kp LEFT, &kp DOWN, &kp UP,   &kp RGHT,
X_NA,     &kp ALGR, X_NA,     X_NA,     X_NA,     &kp INS,  &kp HOME, &kp PGDN, &kp PGUP, &kp END,
X_NP,     X_NP,     X_NA,     X_NA,     X_NA,     &kp ENT,  &kp BSPC, &kp DEL,  X_NP,     X_NP
          )
#endif
        >;
      };
      MOUR_layer {
        bindings = <
#if defined MIRYOKU_NAV_VI
          SUBMAP(
&rst,     X_NA,     X_NA,     X_NA,     X_NA,     X_NU,     X_NU,     X_NU,     X_NU,     X_NU,
&kp LGUI, &kp LALT, &kp LCTL, &kp LSFT, X_NA,     &kp MS_L, &kp MS_D, &kp MS_U, &kp MS_R, X_NU,
X_NA,     &kp ALGR, X_NA,     X_NA,     X_NA,     &kp WH_L, &kp WH_D, &kp WH_U, &kp WH_R, X_NU,
X_NP,     X_NP,     X_NA,     X_NA,     X_NA,     &kp BTN1, &kp BTN3, &kp BTN2, X_NP,     X_NP
          )
#else
          SUBMAP(
&rst,     X_NA,     X_NA,     X_NA,     X_NA,     X_NU,     X_NU,     X_NU,     X_NU,     X_NU,
&kp LGUI, &kp LALT, &kp LCTL, &kp LSFT, X_NA,     X_NU,     &kp MS_L, &kp MS_D, &kp MS_U, &kp MS_R,
X_NA,     &kp ALGR, X_NA,     X_NA,     X_NA,     X_NU,     &kp WH_L, &kp WH_D, &kp WH_U, &kp WH_R,
X_NP,     X_NP,     X_NA,     X_NA,     X_NA,     &kp BTN1, &kp BTN3, &kp BTN2, X_NP,     X_NP
          )
#endif
        >;
      };
      MEDR_layer {
        bindings = <
#if defined MIRYOKU_NAV_VI
          SUBMAP(
&rst,     X_NA,     X_NA,     X_NA,     X_NA,     &kp RGB_TOG, &kp RGB_MOD, &kp RGB_HUI, &kp RGB_SAI, &kp RGB_VAI,
&kp LGUI, &kp LALT, &kp LCTL, &kp LSFT, X_NA,     &kp MPRV, &kp VOLD, &kp VOLU, &kp MNXT, X_NU,
X_NA,     &kp ALGR, X_NA,     X_NA,     X_NA,     X_NU,     X_NU,     X_NU,     X_NU,     X_NU,
X_NP,     X_NP,     X_NA,     X_NA,     X_NA,     &kp MSTP, &kp MPLY, &kp MUTE, X_NP,     X_NP
          )
#else
          SUBMAP(
&rst,     X_NA,     X_NA,     X_NA,     X_NA,     &kp RGB_TOG, &kp RGB_MOD, &kp RGB_HUI, &kp RGB_SAI, &kp RGB_VAI,
&kp LGUI, &kp LALT, &kp LCTL, &kp LSFT, X_NA,     X_NU,     &kp MPRV, &kp VOLD, &kp VOLU, &kp MNXT,
X_NA,     &kp ALGR, X_NA,     X_NA,     X_NA,     X_NU,     X_NU,     X_NU,     X_NU,     X_NU,
X_NP,     X_NP,     X_NA,     X_NA,     X_NA,     &kp MSTP, &kp MPLY, &kp MUTE, X_NP,     X_NP
          )
#endif
        >;
      };
      FUNL_layer {
        bindings = <
          SUBMAP(
&kp F12,  &kp F7,   &kp F8,   &kp F9,   &kp PSCR, X_NA,     X_NA,     X_NA,     X_NA,     &rst,
&kp F11,  &kp F4,   &kp F5,   &kp F6,   &kp SLCK, X_NA,     &kp LSFT, &kp LCTL, &kp LALT, &kp LGUI,
&kp F10,  &kp F1,   &kp F2,   &kp F3,   &kp PAUS, X_NA,     X_NA,     X_NA,     &kp ALGR, X_NA,
X_NP,     X_NP,     &kp APP,  &kp SPC,  &kp TAB,  X_NA,     X_NA,     X_NA,     X_NP,     X_NP
          )
        >;
      };
      NSL_layer {
        bindings = <
          SUBMAP(
&kp LBRC, &kp 7,    &kp 8,    &kp 9,    &kp RBRC, X_NA,     X_NA,     X_NA,     X_NA,     &rst,
&kp SCLN, &kp 4,    &kp 5,    &kp 6,    &kp EQL,  X_NA,     &kp LSFT, &kp LCTL, &kp LALT, &kp LGUI,
&kp GRV,  &kp 1,    &kp 2,    &kp 3,    &kp BSLS, X_NA,     X_NA,     X_NA,     &kp ALGR, X_NA,
X_NP,     X_NP,     &kp DOT,  &kp 0,    &kp MINS, X_NA,     X_NA,     X_NA,     X_NP,     X_NP
          )
        >;
      };
      NSSL_layer {
        bindings = <
          SUBMAP(
&kp LCBR, &kp AMPR, &kp ASTR, &kp LPRN, &kp RCBR, X_NA,     X_NA,     X_NA,     X_NA,     &rst,
&kp COLN, &kp DLR,  &kp PERC, &kp CIRC, &kp PLUS, X_NA,     &kp LSFT, &kp LCTL, &kp LALT, &kp LGUI,
&kp TILD, &kp EXLM, &kp AT,   &kp HASH, &kp PIPE, X_NA,     X_NA,     X_NA,     &kp ALGR, X_NA,
X_NP,     X_NP,     &kp LPRN, &kp RPRN, &kp UNDS, X_NA,     X_NA,     X_NA,     X_NP,     X_NP
          )
        >;
      };
    };
  };
};
